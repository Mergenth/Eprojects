#include <ESP8266WiFi.h>
#include <NTPClient.h>
#include <WiFiUdp.h>
//oled
#include <SPI.h>
#include <Adafruit_SSD1306.h>
//bot
#include <ESP8266HTTPClient.h>
#include <WiFiClient.h>
#include <UrlEncode.h>
//son

#define SCREEN_WIDTH 128 // OLED display width, in pixels
#define SCREEN_HEIGHT 64 // OLED display height, in pixels
#define OLED_MOSI   D7
#define OLED_CLK   D5
#define OLED_DC    D2
#define OLED_CS    D8
#define OLED_RESET D3
Adafruit_SSD1306 display(SCREEN_WIDTH, SCREEN_HEIGHT,
  OLED_MOSI, OLED_CLK, OLED_DC, OLED_RESET, OLED_CS);

//tel
String phoneNumber1 = "PHONENUMBER1";
String apiKey1 = "APIKEY1";

String phoneNumber2 = "PHONENUMBER2";
String apiKey2 ="APIKEY2";
// 'kalp-gun', 48x46px
const unsigned char kalp_gun [] PROGMEM = {
	0x01, 0xff, 0x00, 0x01, 0xff, 0x00, 0x03, 0xff, 0x80, 0x03, 0xff, 0xc0, 0x07, 0xff, 0xc0, 0x07, 
	0xff, 0xe0, 0x0f, 0xff, 0xe0, 0x0f, 0xff, 0xf0, 0x1f, 0xff, 0xf0, 0x1f, 0xff, 0xf8, 0x1f, 0xff, 
	0xf8, 0x3f, 0xff, 0xfc, 0x3f, 0xff, 0xfc, 0x7f, 0xff, 0xfc, 0x7f, 0xff, 0xfe, 0xff, 0xff, 0xfe, 
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	0x01, 0x00, 0x00, 0x00
};

// 'kalp-ay', 48x46px
const unsigned char kalp_ay [] PROGMEM = {
	0x01, 0xff, 0x00, 0x01, 0xff, 0x00, 0x03, 0xff, 0x80, 0x03, 0xff, 0xc0, 0x07, 0xff, 0xc0, 0x07, 
	0xff, 0xe0, 0x0f, 0xff, 0xe0, 0x0f, 0xff, 0xf0, 0x1f, 0xff, 0xf0, 0x1f, 0xff, 0xf8, 0x1f, 0xff, 
	0xf8, 0x3f, 0xff, 0xfc, 0x3f, 0xff, 0xfc, 0x7f, 0xff, 0xfc, 0x7f, 0xff, 0xfe, 0xff, 0xff, 0xfe, 
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	0x01, 0x00, 0x00, 0x00
};

// 'digit_0', 16x28px
const unsigned char bitmap_digit_0 [] PROGMEM = {
	0x0f, 0xff, 0x1f, 0xff, 0x7f, 0xff, 0xff, 0xff, 0xff, 0xff, 0xff, 0xff, 0xfc, 0x3f, 0xfc, 0x3f, 
	0xfc, 0x3f, 0xfc, 0x3f, 0xfc, 0x3f, 0xfc, 0x3f, 0xfc, 0x3f, 0xfc, 0x3f, 0xfc, 0x3f, 0xfc, 0x3f, 
	0xfc, 0x3f, 0xfc, 0x3f, 0xfc, 0x3f, 0xfc, 0x3f, 0xfc, 0x3f, 0xfc, 0x3f, 0xfc, 0x3f, 0xff, 0xff, 
	0xff, 0xff, 0xff, 0xfe, 0xff, 0xfc, 0xff, 0xf8
};
// 'digit_1', 16x28px
const unsigned char bitmap_digit_1 [] PROGMEM = {
	0x01, 0xf8, 0x03, 0xf8, 0x07, 0xf8, 0x1f, 0xf8, 0x1f, 0xf8, 0x1f, 0xf8, 0x1f, 0xf8, 0x1f, 0xf8, 
	0x01, 0xf8, 0x01, 0xf8, 0x01, 0xf8, 0x01, 0xf8, 0x01, 0xf8, 0x01, 0xf8, 0x01, 0xf8, 0x01, 0xf8, 
	0x01, 0xf8, 0x01, 0xf8, 0x01, 0xf8, 0x01, 0xf8, 0x01, 0xf8, 0x01, 0xf8, 0x01, 0xf8, 0x01, 0xf8, 
	0x01, 0xf8, 0x01, 0xf8, 0x01, 0xf8, 0x01, 0xf8
};
// 'digit_2', 16x28px
const unsigned char bitmap_digit_2 [] PROGMEM = {
	0x0f, 0xfe, 0x1f, 0xff, 0x3f, 0xff, 0x7f, 0xff, 0xff, 0xff, 0xff, 0xff, 0xfc, 0x3f, 0xfc, 0x3f, 
	0xfc, 0x3f, 0x00, 0x3f, 0x00, 0x7f, 0x00, 0xff, 0x01, 0xfe, 0x03, 0xfc, 0x0f, 0xf8, 0x1f, 0xf0, 
	0x3f, 0xe0, 0x7f, 0xc0, 0xff, 0x00, 0xfe, 0x00, 0xfc, 0x00, 0xfc, 0x00, 0xfc, 0x00, 0xff, 0xff, 
	0xff, 0xff, 0xff, 0xff, 0xff, 0xff, 0xff, 0xff
};
// 'digit_3', 16x28px
const unsigned char bitmap_digit_3 [] PROGMEM = {
	0x0f, 0xfe, 0x3f, 0xff, 0x7f, 0xff, 0xff, 0xff, 0xff, 0xff, 0xff, 0xff, 0xf8, 0x3f, 0xf8, 0x3f, 
	0xf8, 0x3f, 0x00, 0x3f, 0x00, 0x3f, 0x00, 0xfe, 0x00, 0xfc, 0x00, 0xf8, 0x00, 0xff, 0x00, 0xff, 
	0x00, 0xff, 0x00, 0x3f, 0x00, 0x3f, 0xf8, 0x3f, 0xf8, 0x3f, 0xf8, 0x3f, 0xfc, 0x3f, 0xff, 0xff, 
	0xff, 0xff, 0xff, 0xfe, 0xff, 0xfc, 0xff, 0xf8
};
// 'digit_4', 16x28px
const unsigned char bitmap_digit_4 [] PROGMEM = {
	0x00, 0x70, 0x00, 0x78, 0x00, 0xfc, 0x00, 0xfe, 0x01, 0xff, 0x03, 0xff, 0x03, 0xff, 0x07, 0xff, 
	0x07, 0xff, 0x0f, 0xff, 0x0f, 0xbf, 0x1f, 0xbf, 0x1f, 0x3f, 0x3f, 0x3f, 0x3e, 0x3f, 0x7e, 0x3f, 
	0x7c, 0x3f, 0xfc, 0x3f, 0xff, 0xff, 0x7f, 0xff, 0x3f, 0xff, 0x3f, 0xff, 0x1f, 0xff, 0x00, 0x3f, 
	0x00, 0x3f, 0x00, 0x3f, 0x00, 0x3f, 0x00, 0x3f
};
// 'digit_5', 16x28px
const unsigned char bitmap_digit_5 [] PROGMEM = {
	0x7f, 0xfe, 0xff, 0xfe, 0xff, 0xfe, 0xff, 0xfe, 0xff, 0xfe, 0xff, 0xfe, 0xfc, 0x00, 0xfc, 0x00, 
	0xfc, 0x00, 0xfc, 0x00, 0xfe, 0x00, 0xff, 0xf0, 0xff, 0xf8, 0xff, 0xfe, 0xff, 0xfe, 0xff, 0xff, 
	0x00, 0x3f, 0x00, 0x3f, 0x00, 0x3f, 0xfc, 0x3f, 0xfc, 0x3f, 0xfc, 0x3f, 0xfc, 0x7f, 0xff, 0xff, 
	0xff, 0xff, 0x7f, 0xff, 0x3f, 0xff, 0x1f, 0xff
};
// 'digit_6', 16x28px
const unsigned char bitmap_digit_6 [] PROGMEM = {
	0x0f, 0xfe, 0x1f, 0xff, 0x3f, 0xff, 0x7f, 0xff, 0xff, 0xff, 0xff, 0xff, 0xfc, 0x3f, 0xfc, 0x3f, 
	0xfc, 0x3f, 0xfc, 0x00, 0xfc, 0x00, 0xff, 0xfe, 0xff, 0xff, 0xff, 0xff, 0xff, 0xff, 0xff, 0xff, 
	0xff, 0xff, 0xfc, 0x3f, 0xfc, 0x3f, 0xfc, 0x3f, 0xfc, 0x3f, 0xfc, 0x3f, 0xfc, 0x7f, 0xff, 0xff, 
	0xff, 0xfe, 0xff, 0xfc, 0xff, 0xf8, 0xff, 0xf0
};
// 'digit_7', 16x28px
const unsigned char bitmap_digit_7 [] PROGMEM = {
	0xff, 0xf0, 0xff, 0xf8, 0xff, 0xfc, 0xff, 0xfe, 0xff, 0xff, 0xff, 0xff, 0xf8, 0x3e, 0xf8, 0x7e, 
	0xf8, 0x7e, 0x00, 0xfc, 0x00, 0xfc, 0x00, 0xfc, 0x01, 0xf8, 0x01, 0xf8, 0x01, 0xf8, 0x03, 0xf0, 
	0x03, 0xf0, 0x07, 0xf0, 0x07, 0xe0, 0x07, 0xe0, 0x0f, 0xc0, 0x0f, 0xc0, 0x0f, 0xc0, 0x1f, 0x80, 
	0x1f, 0x80, 0x3f, 0x80, 0x3f, 0x00, 0x3f, 0x00
};
// 'digit_8', 16x28px
const unsigned char bitmap_digit_8 [] PROGMEM = {
	0x0f, 0xfe, 0x1f, 0xfe, 0x3f, 0xfe, 0x7f, 0xfe, 0xff, 0xfe, 0xff, 0xfe, 0xfc, 0x3e, 0xfc, 0x3e, 
	0xfc, 0x3e, 0xfc, 0x3e, 0xfc, 0x3e, 0xfc, 0x3e, 0xff, 0xfc, 0xff, 0xf8, 0x1f, 0xff, 0x7f, 0xff, 
	0xff, 0xff, 0xfc, 0x3f, 0xfc, 0x3f, 0xfc, 0x3f, 0xfc, 0x3f, 0xfc, 0x3f, 0xfc, 0x3f, 0xff, 0xff, 
	0xff, 0xff, 0xff, 0xfe, 0xff, 0xfc, 0xff, 0xf8
};
// 'digit_9', 16x28px
const unsigned char bitmap_digit_9 [] PROGMEM = {
	0x07, 0xff, 0x1f, 0xff, 0x3f, 0xff, 0x7f, 0xff, 0xff, 0xff, 0xff, 0xff, 0xfc, 0x3f, 0xfc, 0x3f, 
	0xfc, 0x3f, 0xfc, 0x3f, 0xfc, 0x3f, 0xff, 0xff, 0xff, 0xff, 0xff, 0xff, 0xff, 0xff, 0xff, 0xff, 
	0xff, 0xff, 0x00, 0x3f, 0x00, 0x3f, 0xfc, 0x3f, 0xfc, 0x3f, 0xfc, 0x3f, 0xfc, 0x3f, 0xff, 0xff, 
	0xff, 0xff, 0xff, 0xfe, 0xff, 0xfc, 0xff, 0xf8
};

const int bitmap_allArray_LEN = 10;
const unsigned char* bitmap_allArray[10] = {
	bitmap_digit_0,
	bitmap_digit_1,
	bitmap_digit_2,
	bitmap_digit_3,
	bitmap_digit_4,
	bitmap_digit_5,
	bitmap_digit_6,
	bitmap_digit_7,
	bitmap_digit_8,
	bitmap_digit_9
};


//oled

int gun;
int ay;
int yil;
int yilekstra;
int gecenay;
int gecengun;
int a;


const char* ssid = "SSID1";
const char* password = "PW1";
const char* ssid2 = "SSID2";
const char* password2 = "PW2";
const char* ssid3 = "SSID3";
const char* password3 = "PW3";
const char* ssid4 = "SSID4";
const char* password4 = "PW4";


WiFiUDP ntpUDP;
NTPClient timeClient(ntpUDP);


// mesaj yollama
void sendMessage(String message){

  // Data to send with HTTP POST
  String url1 = "http://api.callmebot.com/whatsapp.php?phone=" + phoneNumber1 + "&apikey=" + apiKey1 + "&text=" + urlEncode(message);
  WiFiClient client;    
  HTTPClient http;
  http.begin(client, url1);

  // Specify content-type header
  http.addHeader("Content-Type", "application/x-www-form-urlencoded");
  
  // Send HTTP POST request
  int httpResponseCode1 = http.POST(url1);
  if (httpResponseCode1 == 200){
    Serial.print("Message sent successfully");
  }
  else{
    Serial.println("Error sending the message");
    Serial.print("HTTP response code: ");
    Serial.println(httpResponseCode1);
  }
  // Data to send with HTTP POST
  String url2 = "http://api.callmebot.com/whatsapp.php?phone=" + phoneNumber2 + "&apikey=" + apiKey2 + "&text=" + urlEncode(message);

  http.begin(client, url2);

  // Specify content-type header
  http.addHeader("Content-Type", "application/x-www-form-urlencoded");
  
  // Send HTTP POST request
  int httpResponseCode2 = http.POST(url2);
  if (httpResponseCode2 == 200){
    Serial.print("Message sent successfully");
  }
  else{
    Serial.println("Error sending the message");
    Serial.print("HTTP response code: ");
    Serial.println(httpResponseCode2);
  }
  // Free resources
  http.end();
}

void setup() {
    Serial.begin(115200);

 // SSD1306_SWITCHCAPVCC = generate display voltage from 3.3V internally
  if(!display.begin(SSD1306_SWITCHCAPVCC)) {
    Serial.println(F("SSD1306 allocation failed"));
    for(;;); // Don't proceed, loop forever
  }
  display.display();
  delay(100);
  display.clearDisplay();
  display.setTextSize(2);
  display.setTextColor(WHITE);




/*WIFI Başlıyor
  
    WiFi.begin(ssid, password);
    while (WiFi.status() != WL_CONNECTED) {
        delay(1000);
        Serial.println("Connecting to WiFi...");
    }
*/
int n = WiFi.scanNetworks();
 for (int i = 0; i < n; ++i) {
  if (WiFi.SSID(i)== ssid ) {
   WiFi.begin(ssid,password); //trying to connect the modem
   break;
   }
   if (WiFi.SSID(i)== ssid2) {
   WiFi.begin(ssid2,password2); //trying to connect the modem
   break;
   }
   if (WiFi.SSID(i)== ssid3) {
   WiFi.begin(ssid3,password3); //trying to connect the modem
    break;
   }
   if (WiFi.SSID(i)== ssid4) {
   WiFi.begin(ssid4,password4); //trying to connect the modem
    break;
   }
 }

while(WiFi.status() != WL_CONNECTED) {
 delay(500);
 }
 WiFi.mode(WIFI_STA);
 Serial.print("CONNECTED TO ACCESS POINT : ");
 Serial.println(ssid);
 Serial.println(WiFi.localIP());
 //it is sending the IP to Arduino's port. So I can see the IP on Serial Monitor
 



  timeClient.begin();
  timeClient.setTimeOffset(10800); // set time offset to your time zone

    timeClient.update();
    time_t epochTime = timeClient.getEpochTime();
    struct tm * timeinfo = gmtime(&epochTime);
    ay = timeinfo->tm_mon + 1;
    yil = 1900 + timeinfo->tm_year;
    gun = timeinfo->tm_mday;


    Serial.println(timeClient.getFormattedTime());

    yilekstra = (yil - 2023);

    if (gun < 3){
      gecenay = (1 + int(ay) + 12*int(yilekstra) );
      gecengun = (timeClient.getEpochTime() - 1664841599) / 86400;
      a = gecenay;
    }
    else {
      gecenay = (2 + int(ay) + 12*int(yilekstra) );
      gecengun = (timeClient.getEpochTime() - 1664841599) / 86400;
      a = gecenay;
    }

  
  
}




void loop() {


int gunyuz = gecengun / 100;
int gunon = (gecengun/10) % 10;
int gunbir = gecengun % 10;

int ayon = (gecenay/10) %10;
int aybir = gecenay %10; 

// wifi
    timeClient.update();
    time_t epochTime = timeClient.getEpochTime();
    struct tm * timeinfo = gmtime(&epochTime);
    ay = timeinfo->tm_mon + 1;
    yil = 1900 + timeinfo->tm_year;
    gun = timeinfo->tm_mday;


    Serial.println(timeClient.getFormattedTime());

    yilekstra = (yil - 2023);

    if (gun < 3){
      gecenay = (1 + int(ay) + 12*int(yilekstra) );
      gecengun = (timeClient.getEpochTime() - 1664841599) / 86400;
    }
    else {
      gecenay = (2 + int(ay) + 12*int(yilekstra) );
      gecengun = (timeClient.getEpochTime() - 1664841599) / 86400;
    }
    // get the number of days passed from a given date

    
    display.drawBitmap(10, 18, bitmap_allArray[gecengun / 100], 16, 28, 1);
    display.drawBitmap(28, 18, bitmap_allArray[(gecengun/10) % 10], 16, 28, 1);
    display.drawBitmap(46, 18, bitmap_allArray[gecengun % 10], 16, 28, 1);
    display.drawBitmap(70, 9, kalp_gun, 48, 46, 1);
    display.display();

    delay(5000);
    display.clearDisplay();

    if (ayon == 0){
      display.drawBitmap(25, 18, bitmap_allArray[gecenay %10], 16, 28, 1);
      display.drawBitmap(60, 9, kalp_ay, 48, 46, 1);
      display.display();

    }    
    else{
      display.drawBitmap(20, 18, bitmap_allArray[(gecenay/10) %10], 16, 28, 1);
      display.drawBitmap(38, 18, bitmap_allArray[gecenay %10], 16, 28, 1);
      display.drawBitmap(70, 9, kalp_ay, 48, 46, 1);
      display.display();
    }
    delay(5000);
    display.clearDisplay();
    if (a != gecenay){
      a = gecenay;
      sendMessage(""Happy" + String(gecenay) + ". Month");

    }


}
